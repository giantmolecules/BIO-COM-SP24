//----------------------------------------------------------------//
//
// SAIC Biological Communications SP24
// Brett Ian Balogh
//
//
// firefly.ino
//
// Firefly simulation
//
//----------------------------------------------------------------//

// Include libraries for TFT
#include <SPI.h>
#include <Adafruit_GFX.h>
#include <Adafruit_ST7789.h>

#define FIREFLY_PIN 5
#define PHOTOCELL_PIN 18
#define NOISE_PIN 17
#define LED_PIN 13
#define BUFLEN 2

// Create a TFT object
Adafruit_ST7789 tft = Adafruit_ST7789(TFT_CS, TFT_DC, TFT_RST);

// 'firefly', 240x135px
const unsigned char epd_bitmap_firefly [] PROGMEM = {
	0x00, 0x00, 0x00, 0x00, 0x00, 0x00, 0x00, 0x00, 0x00, 0x00, 0x00, 0x00, 0x00, 0x00, 0x00, 0x00, 
	0x00, 0x00, 0x00, 0x00, 0x00, 0x00, 0x00, 0x00, 0x00, 0x00, 0x00, 0x00, 0x00, 0x00, 0x00, 0x00, 
	0x00, 0x00, 0x00, 0x00, 0x00, 0x00, 0x00, 0x00, 0x00, 0x00, 0x00, 0x00, 0x00, 0x00, 0x00, 0x00, 
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	0x00, 0x00
};

// Array of all bitmaps for convenience. (Total bytes used to store images in PROGMEM = 4080)
const int epd_bitmap_allArray_LEN = 1;
const unsigned char* epd_bitmap_allArray[1] = {
	epd_bitmap_firefly
};


int ambientLight = 0;
int buffer = 0;
int filterBuffer[BUFLEN];

int filteredValue = 0;
// How many values for our screen buffer = screen width
int screenBuffer[240];
// The current reading from ADC
int currentReading = 0;

int minValue = 4000;
int maxValue = 8000;
// How much above ambiwntLight is a flash
int detectThreshold = 100;
// Keep our own flash time
double flashAccumulator = 0;
// When flashAccumulator equals this we flash
//int flashThreshold = 100;
// Phase is periodic over 2pi
double flashThreshold = 6.2832;
// How long do we flash for
int flashDuration = 20;
int pastTime = 0;

// flash interval
int interval = 30;
// Are we blind or not
bool blind = false;
// How long are we blind. Should be at least as long as flashDuration
int blindDuration = 40;
// Keeps track of how long we've been blind
int blindPastTime = 0;

// x1, y1, x2, y2 for tft plotting
int dataRect[] = { 0, 10, 240, 125 };

// how much we advance phase when we see a flash. 2 works well
double nudgeAmount = 1.75;

//----{SETUP}-----------------------------------------------------//

void setup() {

  // Start Serial COM
  Serial.begin(115200);
  pinMode(LED_PIN, OUTPUT);
  pinMode(FIREFLY_PIN, OUTPUT);
  
  // initialize filter buffer
  for (int i = 0; i < BUFLEN; i++) {
    filterBuffer[i] = 0;
  }

  // initialize screen buffer
  for (int i = 0; i < 240; i++) {
    screenBuffer[i] = 68;
  }

  // turn on backlite
  pinMode(TFT_BACKLITE, OUTPUT);
  digitalWrite(TFT_BACKLITE, HIGH);

  // turn on the TFT / I2C power supply
  pinMode(TFT_I2C_POWER, OUTPUT);
  digitalWrite(TFT_I2C_POWER, HIGH);
  delay(10);

  // initialize TFT
  tft.init(135, 240);  // Init ST7789 240x135
  tft.setRotation(3);
  tft.fillScreen(ST77XX_BLACK);

  // default text size
  tft.setTextSize(2);

  // set text foreground and background colors
  tft.setTextColor(ST77XX_WHITE, ST77XX_BLACK);

  tft.println(F("TFT Initialized"));
  delay(500);
  tft.fillScreen(ST77XX_BLACK);
  tft.setCursor(0, 0);
  tft.println(F("Calibrating"));

  for (int i = 0; i < 10; i++) {
    tft.print(".");
    buffer += analogRead(PHOTOCELL_PIN);
    delay(200);
  }

  ambientLight = buffer / 10;
  tft.fillScreen(ST77XX_BLACK);
  tft.setCursor(0, 0);
  tft.println(F("Done Calibrating"));
  tft.println("");
  tft.print(F("Ambient Light Level is: "));
  tft.println(ambientLight);

  minValue = ambientLight;

  randomSeed(analogRead(NOISE_PIN));
  tft.println("");
  tft.print("Waiting to start...");
  delay(1000);
  delay(random(10000));

  ///tft.fillScreen(ST77XX_BLACK);
  ///tft.drawLine(0, dataRect[1] - 5, 240, dataRect[1] - 5, ST77XX_GREEN);
  ///tft.drawLine(0, dataRect[3] + 5, 240, dataRect[3] + 5, ST77XX_RED);

  tft.drawBitmap(0, 0, epd_bitmap_firefly, 240, 135, 0xc626, ST77XX_BLACK);
}

//----{LOOP}------------------------------------------------------//

void loop() {

  // If not blind, look for flash
  if (blind == false) {

    // Read the photocell
    currentReading = analogRead(PHOTOCELL_PIN);
    // Formatted print for serial plotter
    //Serial.print(0);
    //Serial.print(",");
    //Serial.print(currentReading - ambientLight);
    //Serial.print(",");
    //Serial.println(1000);
    //Serial.println(currentReading-minValue);

    // Decide if we have detected a flash
    // I think I have to change my approach here...
    // Now trying w + Asin(theta)
    if (currentReading > ambientLight + detectThreshold) {
      digitalWrite(LED_PIN, HIGH);
      delay(10);
      digitalWrite(LED_PIN, LOW);
      double flashPower = -nudgeAmount * sin(flashAccumulator);
      flashPower = constrain(flashPower, 0, 1);
      flashAccumulator += flashPower;
    }
  }

  // Add to the flash accumulator
  if (millis() - pastTime > interval) {

    flashAccumulator += 0.1;
    pastTime = millis();

    // Formatted print for serial plotter
    // Serial.print(0);
    // Serial.print(",");
    // Serial.print(flashAccumulator);
    // Serial.print(",");
    // Serial.println(100);
  }

  // Flash if we have accumulated enough power
  if (flashAccumulator >= flashThreshold) {

    blind = true;
    //Serial.println("Blind");
    digitalWrite(FIREFLY_PIN, HIGH);
    delay(flashDuration);
    digitalWrite(FIREFLY_PIN, LOW);
    flashAccumulator = 0;
    blindPastTime = millis();

  } else {

    digitalWrite(FIREFLY_PIN, LOW);
  }

  if (blind == true) {

    if (millis() - blindPastTime > blindDuration) {
      blind = false;
      //Serial.println("Not Blind");
      blindPastTime = millis();
    }
  }

  // Update stuff
  //updateScreenBuffer(flashAccumulator);
  //updateDisplay();
  
}

//----{DISPLAY}------------------------------------------------------//

void updateDisplay() {

  //tft.fillScreen(ST77XX_BLACK);
  tft.fillRect(dataRect[0], dataRect[1], dataRect[2], dataRect[3], ST77XX_BLACK);
  for (int i = 0; i < 239; i++) {
    //tft.drawPixel(i, screenBuffer[i], ST77XX_WHITE);
    tft.drawLine(i, screenBuffer[i], i + 1, screenBuffer[i + 1], ST77XX_WHITE);
  }
}

//----{FILTER BUFFER}------------------------------------------------------//

int updateFilterBuffer(int val) {

  // shift values in the buffer
  for (int i = 0; i < BUFLEN - 1; i++) {
    filterBuffer[i] = filterBuffer[i + 1];
  }

  filterBuffer[BUFLEN - 1] = val;
  int sum = 0;

  for (int i = 0; i < BUFLEN; i++) {
    sum += filterBuffer[i];
  }

  filteredValue = sum / BUFLEN;
  constrain(filteredValue, 0, maxValue);
  return filteredValue;
}

//----{SCREEN BUFFER}------------------------------------------------------//

void updateScreenBuffer(double val) {

  for (int i = 0; i < 239; i++) {
    screenBuffer[i] = screenBuffer[i + 1];
    //tft.drawPixel(i, screenBuffer[i], ST77XX_WHITE);
  }

  //int mappedValue = map(val, minValue, maxValue, 125, 10);
  int mappedValue = map(val*10, 0, 64, dataRect[3], dataRect[1]);

  screenBuffer[239] = mappedValue;
}

//----{END}------------------------------------------------------//